// These arguments were used when this file was generated. They will be automatically applied on subsequent loads 
// via the GUI or CLI invocations. Run CLI with '--help' for additional information on how to override these arguments.
// @cliArgs --board "/ti/boards/CC3220SF_LAUNCHXL" --product "SimpleLinkSDK@3.20.00.06"
// @versions {"data":"2019051709","timestamp":"2019051709","tool":"1.1.792","templates":"2019051709"}

var RTOS = scripting.addModule("/ti/drivers/RTOS");
var SPI = scripting.addModule("/ti/drivers/SPI");
var SPI1 = SPI.addInstance();
var UART = scripting.addModule("/ti/drivers/UART");
var UART1 = UART.addInstance();
var UART2 = UART.addInstance();
var GPIO = scripting.addModule("/ti/drivers/GPIO");
var GPIO1 = GPIO.addInstance();
var GPIO2 = GPIO.addInstance();
var GPIO3 = GPIO.addInstance();
var GPIO4 = GPIO.addInstance();
var GPIO5 = GPIO.addInstance();
var GPIO6 = GPIO.addInstance();
var GPIO7 = GPIO.addInstance();
var GPIO8 = GPIO.addInstance();
var GPIO9 = GPIO.addInstance();
var GPIO10 = GPIO.addInstance();
var GPIO11 = GPIO.addInstance();
var GPIO12 = GPIO.addInstance();
var GPIO13 = GPIO.addInstance();
var Timer = scripting.addModule("/ti/drivers/Timer");
var Timer1 = Timer.addInstance();
var Timer2 = Timer.addInstance();
var Crypto = scripting.addModule("/ti/drivers/Crypto");
var Crypto1 = Crypto.addInstance();
var Watchdog = scripting.addModule("/ti/drivers/Watchdog");
var Watchdog1 = Watchdog.addInstance();
var GPIO14 = GPIO.addInstance();
var SimpleLinkWifi = scripting.addModule("/ti/drivers/net/wifi/SimpleLinkWifi");
var Timer3 = Timer.addInstance();
var Timer4 = Timer.addInstance();
var DMA = scripting.addModule("/ti/drivers/DMA");
var Board = scripting.addModule("/ti/drivers/Board");
var Power = scripting.addModule("/ti/drivers/Power");
// Name
Power.parkPins.$name = "ti_drivers_power_PowerCC32XXPins0";
// Name - The C/C++ identifier used in applications as the index parameter passed to SPI runtime APIs
SPI1.$name = "Board_SPI0";
// Name
SPI1.spi.$name = "MySPI1";
// Name - The C/C++ identifier used in applications as the index parameter passed to UART runtime APIs
UART1.$name = "Board_UART0";
// Data Direction
UART1.dataDirection = "Send Only";
// Name
UART1.uart.$name = "MyUART1";
// Assign pin
UART1.uart.txPin.$assign = "boosterpack.4"; // P03
// Name - The C/C++ identifier used in applications as the index parameter passed to UART runtime APIs
UART2.$name = "Board_UART1";
// Use Hardware - Select the hardware to use, or 'none' to use available header pins
UART2.$hardware = system.deviceData.board.components.xds110Uart;
// Name
UART2.uart.$name = "MyUART1";
// Mode - Select the GPIO mode
GPIO1.mode = "Output";
// Initial Output State
GPIO1.initialOutputState = "High";
// Name - The C/C++ identifier used in applications as the index parameter passed to GPIO runtime APIs
GPIO1.$name = "CS1";
// Assign pin
GPIO1.gpioPin.$assign = "boosterpack.18"; // P08
// Mode - Select the GPIO mode
GPIO2.mode = "Output";
// Initial Output State
GPIO2.initialOutputState = "High";
// Name - The C/C++ identifier used in applications as the index parameter passed to GPIO runtime APIs
GPIO2.$name = "CS2";
// Assign pin
GPIO2.gpioPin.$assign = "boosterpack.5"; // P61
// Mode - Select the GPIO mode
GPIO3.mode = "Output";
// Initial Output State
GPIO3.initialOutputState = "High";
// Name - The C/C++ identifier used in applications as the index parameter passed to GPIO runtime APIs
GPIO3.$name = "CS3";
// Assign pin
GPIO3.gpioPin.$assign = "boosterpack.13"; // P21
// Use Hardware - Select the hardware to use, or 'none' to use available header pins
GPIO4.$hardware = system.deviceData.board.components.LED_GREEN;
// Name - The C/C++ identifier used in applications as the index parameter passed to GPIO runtime APIs
GPIO4.$name = "Board_LEDG";
// Use Hardware - Select the hardware to use, or 'none' to use available header pins
GPIO5.$hardware = system.deviceData.board.components.LED_YELLOW;
// Name - The C/C++ identifier used in applications as the index parameter passed to GPIO runtime APIs
GPIO5.$name = "Board_LEDY";
// Name - The C/C++ identifier used in applications as the index parameter passed to GPIO runtime APIs
GPIO6.$name = "Board_GPIO0";
// Mode - Select the GPIO mode
GPIO6.mode = "Output";
// Name - The C/C++ identifier used in applications as the index parameter passed to GPIO runtime APIs
GPIO7.$name = "Board_GPIO1";
// Name - The C/C++ identifier used in applications as the index parameter passed to GPIO runtime APIs
GPIO8.$name = "Board_GPIO2";
// Mode - Select the GPIO mode
GPIO8.mode = "Output";
// Name - The C/C++ identifier used in applications as the index parameter passed to GPIO runtime APIs
GPIO9.$name = "Board_GPIO3";
// Mode - Select the GPIO mode
GPIO9.mode = "Output";
// Name - The C/C++ identifier used in applications as the index parameter passed to GPIO runtime APIs
GPIO10.$name = "Board_GPIO4";
// Mode - Select the GPIO mode
GPIO10.mode = "Output";
// Name - The C/C++ identifier used in applications as the index parameter passed to GPIO runtime APIs
GPIO11.$name = "Board_GPIO5";
// Mode - Select the GPIO mode
GPIO11.mode = "Output";
// Name - The C/C++ identifier used in applications as the index parameter passed to GPIO runtime APIs
GPIO12.$name = "Board_GPIO6";
// Mode - Select the GPIO mode
GPIO12.mode = "Output";
// Name - The C/C++ identifier used in applications as the index parameter passed to GPIO runtime APIs
GPIO13.$name = "Board_GPIO7";
// Mode - Select the GPIO mode
GPIO13.mode = "Output";
// Name - The C/C++ identifier used in applications as the index parameter passed to Timer runtime APIs
Timer1.$name = "Board_TIMER0";
// Timer Type
Timer1.timerType = "32 Bits";
// Name
Timer1.timer.$name = "MyTimer1";
// Name - The C/C++ identifier used in applications as the index parameter passed to Timer runtime APIs
Timer2.$name = "Board_TIMER1";
// Timer Type
Timer2.timerType = "32 Bits";
// Name
Timer2.timer.$name = "MyTimer1";
// Name - The C/C++ identifier used in applications as the index parameter passed to Crypto runtime APIs
Crypto1.$name = "Board_Crypto0";
// Name - The C/C++ identifier used in applications as the index parameter passed to Watchdog runtime APIs
Watchdog1.$name = "Board_WATCHDOG0";
// Name
Watchdog1.watchdog.$name = "MyWATCHDOG1";
// Use Hardware - Select the hardware to use, or 'none' to use available header pins
GPIO14.$hardware = system.deviceData.board.components.LED_RED;
// Name - The C/C++ identifier used in applications as the index parameter passed to GPIO runtime APIs
GPIO14.$name = "Board_LEDR";
// Name - The C/C++ identifier used in applications as the index parameter passed to Timer runtime APIs
Timer3.$name = "Board_TIMER2";
// Name
Timer3.timer.$name = "MyTimer1";
// Name - The C/C++ identifier used in applications as the index parameter passed to Timer runtime APIs
Timer4.$name = "Board_TIMER3";
// Name
Timer4.timer.$name = "MyTimer1";
// Suggest solution
SPI1.spi.$suggestSolution = "SPI0";
// Suggest solution
SPI1.spi.sclkPin.$suggestSolution = "5";
// Suggest solution
SPI1.spi.misoPin.$suggestSolution = "6";
// Suggest solution
SPI1.spi.mosiPin.$suggestSolution = "7";
// Suggest solution
SPI1.spi.dmaRxChannel.$suggestSolution = "UDMA_CH30";
// Suggest solution
SPI1.spi.dmaTxChannel.$suggestSolution = "UDMA_CH31";
// Suggest solution
UART1.uart.$suggestSolution = "UART0";
// Suggest solution
UART2.uart.$suggestSolution = "UART1";
// Suggest solution
UART2.uart.txPin.$suggestSolution = "55";
// Suggest solution
UART2.uart.rxPin.$suggestSolution = "57";
// Suggest solution
GPIO4.gpioPin.$suggestSolution = "2";
// Suggest solution
GPIO5.gpioPin.$suggestSolution = "1";
// Suggest solution
GPIO6.gpioPin.$suggestSolution = "18";
// Suggest solution
GPIO7.gpioPin.$suggestSolution = "45";
// Suggest solution
GPIO8.gpioPin.$suggestSolution = "50";
// Suggest solution
GPIO9.gpioPin.$suggestSolution = "53";
// Suggest solution
GPIO10.gpioPin.$suggestSolution = "58";
// Suggest solution
GPIO11.gpioPin.$suggestSolution = "59";
// Suggest solution
GPIO12.gpioPin.$suggestSolution = "60";
// Suggest solution
GPIO13.gpioPin.$suggestSolution = "62";
// Suggest solution
Timer1.timer.$suggestSolution = "Timer2";
// Suggest solution
Timer2.timer.$suggestSolution = "Timer1";
// Suggest solution
Watchdog1.watchdog.$suggestSolution = "WATCHDOG0";
// Suggest solution
GPIO14.gpioPin.$suggestSolution = "64";
// Suggest solution
Timer3.timer.$suggestSolution = "Timer0";
// Suggest solution
Timer4.timer.$suggestSolution = "Timer0";
